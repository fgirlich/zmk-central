## config/boards/shields/rdk/Kconfig.shield
```kconfig
config SHIELD_RDK_LEFT
	def_bool $(shields_list_contains,rdk_left)

config SHIELD_RDK_RIGHT
	def_bool $(shields_list_contains,rdk_right)

config SHIELD_RDK_CENTER
	def_bool $(shields_list_contains,rdk_center)
```
